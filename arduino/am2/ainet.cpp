#include "ainet.h"

const int AINETIN = 3;
const int AINETOUT = 21;
bool fast_byte_buffer[88];
uint8_t i,j,type;
bool ainetInit = false;
bool ainetAck = false;


//definitions of different ainet arrays
const int AINET_COMMANDS_NUM = 20;
const byte VOL_LEN=36;

uint8_t ainet_commands[AINET_COMMANDS_NUM][11]={
{0x40,0x02,0x50,0x08,0x00,0x00,0x00,0x00,0x00,0x00,0x90}, // 0 H701 detection
{0x40,0x02,0x90,0x67,0x40,0x22,0x00,0x00,0x00,0x00,0xda}, //init, 1st command // not necessary ?
{0x40,0x02,0xe2,0x64,0x00,0x00,0x00,0x00,0x00,0x00,0x2e}, //init, 2nd command //enable presets
{0x40,0x02,0x90,0x67,0x25,0x00,0x00,0x00,0x00,0x00,0xf4}, //init, 3rd command
{0x40,0x02,0x90,0x67,0x5b,0x00,0x00,0x00,0x00,0x00,0x1b}, //init, 4th command
{0x40,0x50,0x90,0x67,0x41,0x23,0x00,0x00,0x00,0x00,0x5a}, //init, 5th command
{0x40,0x02,0xa0,0x70,0x00,0x00,0x00,0x00,0x00,0x00,0x1e}, // 6 init, 6th command -- enable the processor
{0x40,0x02,0xD2,0x99,0x00,0x00,0x00,0x00,0x00,0x00,0xD7}, // 7 volume 0
{0x40,0x02,0xd3,0x31,0x00,0x00,0x00,0x00,0x00,0x00,0x94}, //Balance L15
{0x40,0x02,0xd4,0x4f,0x00,0x00,0x00,0x00,0x00,0x00,0x1d}, //Fader F15
{0x40,0x50,0x04,0xD2,0x64,0x01,0x00,0x00,0x00,0x00,0x23}, //preset 1
{0x00,0x00,0x00,0x00,0x00,0x00,0x00,0x00,0x00,0x00,0x00}, //user command to send
{0x40,0x02,0xd0,0x24,0x00,0x00,0x00,0x00,0x00,0x00,0xf8}, // 12 activate A1 input| (4th byte) 2a  - D1
{0x40,0x50,0x02,0xd1,0x73,0x00,0x00,0x00,0x00,0x00,0xaa}, //Sub. level +1
{0x40,0x50,0x02,0xd1,0x63,0x00,0x00,0x00,0x00,0x00,0xbe}, //Sub. level -1
{0x32,0x02,0x10,0x90,0x67,0x20,0x05,0x00,0x00,0x00,0x4a}, //Confirmation for CD Ch init
{0x32,0x02,0xa1,0x70,0x00,0x00,0x00,0x00,0x00,0x00,0xaa}, //CD Ch init #2
{0x32,0x50,0xd3,0x70,0x00,0x00,0x00,0x00,0x00,0x00,0x50}, //CD Ch play 
{0x32,0x50,0xd5,0x75,0x00,0x00,0x00,0x00,0x00,0x00,0x00}, //CD Ch disk/track control
{0x40,0x02,0xd6,0x70,0x00,0x00,0x00,0x00,0x00,0x00,0x29},// 19  unmute  
};

uint8_t vol[VOL_LEN]={0x99,0x78,0x68,0x60,0x55,0x50,0x48,0x46,0x44,0x42,
                      0x40,0x38,0x36,0x34,0x32,0x30,0x28,0x26,0x24,0x22,
                      0x20,0x18,0x16,0x14,0x12,0x10,0x09,0x08,0x07,0x06,
                      0x05,0x04,0x03,0x02,0x01,0x00};

//end 





void crc(uint8_t *packet) {
  uint8_t crc_reg=0xff,poly,i,j;
  uint8_t bit_point, *byte_point;
  for (i=0, byte_point=packet; i<10; ++i, ++byte_point) {
    for (j=0, bit_point=0x80 ; j<8; ++j, bit_point>>=1) {
      if (bit_point & *byte_point) { // case for new bit =1
        if (crc_reg & 0x80) poly=1; // define the polynomial
        else poly=0x1c;
        crc_reg= ( (crc_reg << 1) | 1) ^ poly;
      } else { // case for new bit =0
        poly=0;
        if (crc_reg & 0x80) poly=0x1d;
        crc_reg= (crc_reg << 1) ^ poly;
      }
    }
  }
  packet[10]= ~crc_reg; // write use CRC
}



void fastSend(bool* packet, int packet_size, bool ack){
  noInterrupts();
  if (!ack){
    digitalWrite2(AINETOUT, HIGH);
    delayMicroseconds(32);
    digitalWrite2(AINETOUT, LOW);
    delayMicroseconds(16);
  }
  
  for (int i = 0; i< packet_size; i++){
    if (packet[i] == 0){
      digitalWrite2(AINETOUT, HIGH);
      delayMicroseconds(14);
      digitalWrite2(AINETOUT, LOW);
      delayMicroseconds(8);
    }
    else {
      digitalWrite2(AINETOUT, HIGH);
      delayMicroseconds(5);
      digitalWrite2(AINETOUT, LOW);
      delayMicroseconds(18);
    }
  }
  delayMicroseconds(252);
  interrupts();
}


void sendAiNetCommand(byte * packet, int packet_size){
  for (i=0;i<packet_size;i++) {
    for (j=0;j<8;j++) {
      type=(packet[i] & (1 << (7-j))) >> (7-j);
      if (type==0) {
        fast_byte_buffer[i*8+j] = 0;
      }
      else {
        fast_byte_buffer[i*8+j] = 1;
      }
    }
  }
  fastSend(fast_byte_buffer, packet_size*8, false);
  
}


//aiNet Processor init
void init_ainet_processor(){
  if (ainetAck == true){ //start ainet processor init seq.
    ainetInit = true;
    ainetAck = false;//we init it only once
    delay(2000);
    Serial.println("int seq initiated");
    sendAiNetCommand(ainet_commands[0],11);    
    delay(24);
    sendAiNetCommand(ainet_commands[6],11);
    delay(65);
    ainet_commands[12][3] = 0x2a;
    crc(ainet_commands[12]);
    sendAiNetCommand(ainet_commands[12],11);
    delay(90);
    ainet_commands[7][3] = vol[0];
    crc(ainet_commands[7]);
    sendAiNetCommand(ainet_commands[7],11);
    delay(50);
    sendAiNetCommand(ainet_commands[19],11);
    delay(50);
    sendAiNetCommand(ainet_commands[2],11);    
    delay(60);
    sendAiNetCommand(ainet_commands[8],11);   
    delay(30);
    sendAiNetCommand(ainet_commands[9],11);   
    //restore volume to mid level
    delay(5000);
    Serial.println("Restore volume level");
    ainet_commands[7][3] = vol[15];
    crc(ainet_commands[7]);
    sendAiNetCommand(ainet_commands[7],11);
  }
}
//End of aiNet processor init

